## configs/rpi2_aroio_defconfig
```kconfig
BR2_arm=y
BR2_cortex_a7=y
BR2_ARM_FPU_NEON_VFPV4=y
BR2_KERNEL_MIRROR="https://www.kernel.org/pub"
BR2_GNU_MIRROR="http://ftp.gnu.org/pub/gnu"
BR2_CCACHE=y
# BR2_COMPILER_PARANOID_UNSAFE_PATH is not set
BR2_KERNEL_HEADERS_4_4=y
BR2_TOOLCHAIN_BUILDROOT_GLIBC=y
BR2_GLIBC_VERSION_2_23=y
BR2_BINUTILS_VERSION_2_26_X=y
BR2_TOOLCHAIN_BUILDROOT_CXX=y
BR2_PACKAGE_HOST_GDB=y
BR2_GDB_VERSION_7_11=y
BR2_ENABLE_LOCALE_PURGE=y
BR2_ENABLE_LOCALE_WHITELIST="C en_US de "
BR2_TARGET_GENERIC_HOSTNAME="aroio"
BR2_TARGET_GENERIC_ISSUE="Welcome to AroioEX"
BR2_ROOTFS_DEVICE_CREATION_DYNAMIC_EUDEV=y
BR2_TARGET_GENERIC_ROOT_PASSWD="aroio"
BR2_SYSTEM_DHCP="eth0"
BR2_ROOTFS_USERS_TABLES="board/abacus/rpi2/aroio_users_table"
BR2_ROOTFS_OVERLAY="board/abacus/rpi2/overlay_aroio"
BR2_ROOTFS_POST_BUILD_SCRIPT="board/abacus/rpi2/post-build_aroio.sh"
BR2_ROOTFS_POST_IMAGE_SCRIPT="board/abacus/rpi2/post-image_aroio.sh"
BR2_LINUX_KERNEL=y
BR2_LINUX_KERNEL_CUSTOM_GIT=y
BR2_LINUX_KERNEL_CUSTOM_REPO_URL="https://github.com/raspberrypi/linux"
BR2_LINUX_KERNEL_CUSTOM_REPO_VERSION="dd9188011786fb62a7960922f31e8e086fb2009b"
BR2_LINUX_KERNEL_PATCH="board/abacus/rpi2/usb-audio-lynxhilo-clocksrc.patch board/abacus/rpi2/linux-patches/patch-4.4.21-rt30.patch"
BR2_LINUX_KERNEL_USE_CUSTOM_CONFIG=y
BR2_LINUX_KERNEL_CUSTOM_CONFIG_FILE="$(TOPDIR)/board/abacus/rpi2/kernel_defconfig"
BR2_LINUX_KERNEL_DTS_SUPPORT=y
BR2_LINUX_KERNEL_INTREE_DTS_NAME="bcm2709-rpi-2-b bcm2710-rpi-3-b overlays/i2s-mmap-overlay overlays/iqaudio-dacplus-overlay"
BR2_PACKAGE_BUSYBOX_CONFIG="board/abacus/rpi2/busybox_aroio.config"
BR2_PACKAGE_BUSYBOX_SHOW_OTHERS=y
BR2_PACKAGE_ALSA_UTILS=y
BR2_PACKAGE_ALSA_UTILS_ALSACONF=y
BR2_PACKAGE_ALSA_UTILS_AMIXER=y
BR2_PACKAGE_ALSA_UTILS_APLAY=y
BR2_PACKAGE_BRUTEFIR=y
BR2_PACKAGE_FFMPEG_GPL=y
BR2_PACKAGE_FFMPEG_NONFREE=y
BR2_PACKAGE_FFMPEG_ENCODERS=""
BR2_PACKAGE_FFMPEG_MUXERS=""
BR2_PACKAGE_FFMPEG_FILTERS=""
# BR2_PACKAGE_FFMPEG_INDEVS is not set
BR2_PACKAGE_GMRENDER_RESURRECT=y
# BR2_PACKAGE_GSTREAMER1_TRACE is not set
# BR2_PACKAGE_GSTREAMER1_GST_DEBUG is not set
BR2_PACKAGE_GST1_PLUGINS_BASE_PLUGIN_AUDIORATE=y
BR2_PACKAGE_GST1_PLUGINS_BASE_PLUGIN_AUDIOTESTSRC=y
# BR2_PACKAGE_GST1_PLUGINS_BASE_PLUGIN_VIDEOSCALE is not set
BR2_PACKAGE_GST1_PLUGINS_BASE_PLUGIN_ALSA=y
BR2_PACKAGE_GST1_PLUGINS_GOOD=y
BR2_PACKAGE_GST1_PLUGINS_GOOD_PLUGIN_AUDIOPARSERS=y
# BR2_PACKAGE_GST1_PLUGINS_GOOD_PLUGIN_AVI is not set
BR2_PACKAGE_GST1_PLUGINS_GOOD_PLUGIN_JACK=y
# BR2_PACKAGE_GST1_PLUGINS_GOOD_PLUGIN_ISOMP4 is not set
BR2_PACKAGE_GST1_PLUGINS_GOOD_PLUGIN_MULTIFILE=y
BR2_PACKAGE_GST1_PLUGINS_GOOD_PLUGIN_MULTIPART=y
BR2_PACKAGE_GST1_PLUGINS_GOOD_PLUGIN_FLAC=y
BR2_PACKAGE_GST1_PLUGINS_BAD=y
BR2_PACKAGE_GST1_PLUGINS_BAD_PLUGIN_RAWPARSE=y
BR2_PACKAGE_GST1_PLUGINS_BAD_PLUGIN_FAAD=y
BR2_PACKAGE_GST1_PLUGINS_BAD_PLUGIN_OPUS=y
BR2_PACKAGE_GST1_PLUGINS_UGLY=y
BR2_PACKAGE_GST1_PLUGINS_UGLY_PLUGIN_MAD=y
BR2_PACKAGE_GST1_LIBAV=y
BR2_PACKAGE_SOX=y
BR2_PACKAGE_SQUEEZELITE=y
BR2_PACKAGE_SQUEEZELITE_RESAMPLE=y
BR2_PACKAGE_SQUEEZELITE_JACK=y
BR2_PACKAGE_SQUEEZELITE_JACK_RESAMPLE=y
BR2_PACKAGE_WAVPACK=y
BR2_PACKAGE_BZIP2=y
BR2_PACKAGE_GETTEXT=y
BR2_PACKAGE_LIBTOOL=y
BR2_PACKAGE_NTFS_3G=y
BR2_PACKAGE_LINUX_FIRMWARE=y
BR2_PACKAGE_LINUX_FIRMWARE_RTL_81XX=y
BR2_PACKAGE_RPI_FIRMWARE=y
BR2_PACKAGE_RPI_FIRMWARE_INSTALL_VCDBG=y
BR2_PACKAGE_DBUS_GLIB=y
BR2_PACKAGE_RTL8821AU=y
BR2_PACKAGE_PHP=y
BR2_PACKAGE_AUDIOFILE=y
BR2_PACKAGE_SPEEX=y
BR2_PACKAGE_SWH_LADSPA_PLUGINS=y
BR2_PACKAGE_GNUTLS=y
BR2_PACKAGE_LIBGCRYPT=y
BR2_PACKAGE_POLARSSL=y
BR2_PACKAGE_BERKELEYDB=y
BR2_PACKAGE_LIBNFS=y
BR2_PACKAGE_LIBGUDEV=y
BR2_PACKAGE_LIBOPENH264=y
BR2_PACKAGE_LIBNDP=y
BR2_PACKAGE_LIBTIRPC=y
BR2_PACKAGE_LIBUPNPP=y
BR2_PACKAGE_NEWT=y
BR2_PACKAGE_AVAHI=y
BR2_PACKAGE_AVAHI_DAEMON=y
BR2_PACKAGE_AVAHI_LIBDNSSD_COMPATIBILITY=y
BR2_PACKAGE_DHCPCD=y
BR2_PACKAGE_DROPBEAR=y
BR2_PACKAGE_DROPBEAR_DISABLE_REVERSEDNS=y
BR2_PACKAGE_HOSTAPD=y
BR2_PACKAGE_HOSTAPD_WPS=y
BR2_PACKAGE_IW=y
BR2_PACKAGE_NETPLUG=y
BR2_PACKAGE_SAMBA4=y
BR2_PACKAGE_SHAIRPORT_SYNC=y
BR2_PACKAGE_SHAIRPORT_SYNC_LIBSOXR=y
BR2_PACKAGE_SLIMSERVER=y
BR2_PACKAGE_WIRELESS_TOOLS=y
BR2_PACKAGE_WIRELESS_TOOLS_LIB=y
BR2_PACKAGE_WPA_SUPPLICANT=y
BR2_PACKAGE_WPA_SUPPLICANT_EAP=y
BR2_PACKAGE_WPA_SUPPLICANT_HOTSPOT=y
BR2_PACKAGE_WPA_SUPPLICANT_WPS=y
BR2_PACKAGE_WPA_SUPPLICANT_CLI=y
BR2_PACKAGE_WPA_SUPPLICANT_PASSPHRASE=y
BR2_PACKAGE_INOTIFY_TOOLS=y
BR2_PACKAGE_PROCPS_NG=y
BR2_PACKAGE_NANO=y
BR2_TARGET_ROOTFS_EXT2=y
BR2_TARGET_ROOTFS_EXT2_4=y
BR2_TARGET_ROOTFS_EXT2_EXTRA_BLOCKS=80904
BR2_PACKAGE_HOST_DOSFSTOOLS=y
BR2_PACKAGE_HOST_GENIMAGE=y
BR2_PACKAGE_HOST_MTOOLS=y
```

## configs/rpi2_audiostreamer_defconfig
```kconfig
BR2_arm=y
BR2_cortex_a7=y
BR2_ARM_FPU_NEON_VFPV4=y
BR2_CCACHE=y
BR2_KERNEL_HEADERS_4_1=y
BR2_TOOLCHAIN_BUILDROOT_GLIBC=y
BR2_TOOLCHAIN_BUILDROOT_CXX=y
BR2_PACKAGE_HOST_GDB=y
BR2_TARGET_GENERIC_ROOT_PASSWD="toor"
# BR2_TARGET_GENERIC_GETTY is not set
BR2_SYSTEM_DHCP="eth0"
BR2_ROOTFS_OVERLAY="board/arne/rpi2/overlay_audiostreamer"
BR2_ROOTFS_POST_IMAGE_SCRIPT="board/arne/rpi2/post-image.sh"
BR2_LINUX_KERNEL=y
BR2_LINUX_KERNEL_CUSTOM_GIT=y
BR2_LINUX_KERNEL_CUSTOM_REPO_URL="https://github.com/raspberrypi/linux"
BR2_LINUX_KERNEL_CUSTOM_REPO_VERSION="aad4e7c34665e3f2fd4e7cb613aeca231e09ac5c"
BR2_LINUX_KERNEL_USE_CUSTOM_CONFIG=y
BR2_LINUX_KERNEL_CUSTOM_CONFIG_FILE="$(TOPDIR)/board/arne/rpi2/kernel_defconfig"
BR2_LINUX_KERNEL_ZIMAGE=y
BR2_LINUX_KERNEL_DTS_SUPPORT=y
BR2_LINUX_KERNEL_INTREE_DTS_NAME="bcm2709-rpi-2-b overlays/i2s-mmap-overlay overlays/iqaudio-dacplus-overlay"
BR2_PACKAGE_BUSYBOX_CONFIG="board/arne/rpi2/busybox.config"
BR2_PACKAGE_ALSA_UTILS=y
BR2_PACKAGE_ALSA_UTILS_ALSACONF=y
BR2_PACKAGE_ALSA_UTILS_APLAY=y
BR2_PACKAGE_BRUTEFIR=y
BR2_PACKAGE_GSTREAMER=y
# BR2_PACKAGE_GST_PLUGINS_BASE_PLUGIN_FFMPEGCOLORSPACE is not set
# BR2_PACKAGE_GST_PLUGINS_BASE_PLUGIN_VIDEOSCALE is not set
BR2_PACKAGE_GST_PLUGINS_BASE_PLUGIN_ALSA=y
BR2_PACKAGE_GST_PLUGINS_BASE_PLUGIN_OGG=y
BR2_PACKAGE_GST_PLUGINS_GOOD=y
# BR2_PACKAGE_GST_PLUGINS_GOOD_PLUGIN_AVI is not set
BR2_PACKAGE_GST_PLUGINS_GOOD_PLUGIN_FLAC=y
BR2_PACKAGE_GST_PLUGINS_GOOD_PLUGIN_JACK=y
BR2_PACKAGE_GST_PLUGINS_BAD=y
BR2_PACKAGE_GST_PLUGINS_UGLY=y
BR2_PACKAGE_GST_PLUGINS_UGLY_PLUGIN_MAD=y
BR2_PACKAGE_SQUEEZELITE=y
BR2_PACKAGE_SQUEEZELITE_RESAMPLE=y
BR2_PACKAGE_SQUEEZELITE_JACK=y
BR2_PACKAGE_SQUEEZELITE_JACK_RESAMPLE=y
BR2_PACKAGE_GETTEXT=y
BR2_PACKAGE_RPI_FIRMWARE=y
BR2_PACKAGE_RPI_FIRMWARE_INSTALL_VCDBG=y
BR2_PACKAGE_PERL=y
BR2_PACKAGE_PHP=y
BR2_PACKAGE_OPUS=y
BR2_PACKAGE_LIBNFS=y
BR2_PACKAGE_YAJL=y
BR2_PACKAGE_LIBTIRPC=y
BR2_PACKAGE_LIBUPNPP=y
BR2_PACKAGE_BOOST=y
BR2_PACKAGE_DROPBEAR=y
BR2_PACKAGE_IW=y
BR2_PACKAGE_SAMBA4=y
BR2_PACKAGE_SHAIRPORT_SYNC=y
BR2_PACKAGE_SHAIRPORT_SYNC_LIBSOXR=y
BR2_PACKAGE_WIRELESS_TOOLS=y
BR2_PACKAGE_WPA_SUPPLICANT=y
BR2_PACKAGE_WPA_SUPPLICANT_EAP=y
BR2_PACKAGE_WPA_SUPPLICANT_HOTSPOT=y
BR2_PACKAGE_WPA_SUPPLICANT_WPS=y
BR2_PACKAGE_WPA_SUPPLICANT_CLI=y
BR2_PACKAGE_WPA_SUPPLICANT_PASSPHRASE=y
BR2_TARGET_ROOTFS_CPIO_LZO=y
BR2_TARGET_ROOTFS_INITRAMFS=y
# BR2_TARGET_ROOTFS_TAR is not set
```

## package/brutefir/Config.in
```kconfig
config BR2_PACKAGE_BRUTEFIR
       bool "brutefir"
       help
         brutefir convolver

	 http://www.ludd.luth.se/~torger/brutefir.html
```

## package/gmrender-resurrect/Config.in
```kconfig
config BR2_PACKAGE_GMRENDER_RESURRECT
	bool "gmrender-resurrect"
	select BR2_PACKAGE_GSTREAMER1
	help
	  gmrender-resurrect implements a uPNP renderer.
```

## package/libmediascan/Config.in
```kconfig
config BR2_PACKAGE_LIBMEDIASCAN
	bool "libmediascan"
	select BR2_PACKAGE_LIBEXIF
	select BR2_PACKAGE_PERL
	
	help
          libmediascan is an evolution of the work done on the Perl
          modules Audio::Scan and Image::Scale

	  https://github.com/andygrundman/libmediascan
```

## package/perl-anyevent/Config.in
```kconfig
config BR2_PACKAGE_PERL_ANYEVENT
	bool "perl-anyevent"
	help
	  AnyEvent - the DBI of event loop programming

	  http://search.cpan.org/~mlehmann/AnyEvent-7.12/lib/AnyEvent.pm
```

## package/perl-audio-cuefile-parser/Config.in
```kconfig
config BR2_PACKAGE_PERL_AUDIO_CUEFILE_PARSER
	bool "perl-audio-cuefile-parser"
	help
	  Class to parse a cuefile and access the chewy, nougat centre. Returns Audio::Cuefile::Parser::Track objects.

	  http://search.cpan.org/~mattk/Audio-Cuefile-Parser-0.02/lib/Audio/Cuefile/Parser.pm
```

## package/perl-audio-scan/Config.in
```kconfig
config BR2_PACKAGE_PERL_AUDIO_SCAN
	bool "perl-audio-scan"
	help
	  Audio::Scan - Fast C metadata and tag reader for all common audio file formats

	  http://search.cpan.org/~agrundma/Audio-Scan-0.93/lib/Audio/Scan.pm
```

## package/perl-b-hooks-endofscope/Config.in
```kconfig
config BR2_PACKAGE_PERL_B_HOOKS_ENDOFSCOPE
	bool "perl-b-hooks-endofscope"
	help
	  B::Hooks::EndOfScope - Execute code after a scope finished compilation

	  http://search.cpan.org/~ether/B-Hooks-EndOfScope-0.21/lib/B/Hooks/EndOfScope.pm
```

## package/perl-canary-stability/Config.in
```kconfig
config BR2_PACKAGE_PERL_CANARY_STABILITY
	bool "perl-canary-stability"
	help
	  Canary::Stability - canary to check perl compatibility for schmorp's modules

	  http://search.cpan.org/~mlehmann/Canary-Stability-2011/Stability.pm
```

## package/perl-carp-assert/Config.in
```kconfig
config BR2_PACKAGE_PERL_CARP_ASSERT
	bool "perl-carp-assert"
	help
	  Carp::Assert - executable comments

	  http://search.cpan.org/~neilb/Carp-Assert-0.21/lib/Carp/Assert.pm
```

## package/perl-carp-clan/Config.in
```kconfig
config BR2_PACKAGE_PERL_CARP_CLAN
	bool "perl-carp-clan"
	help
	  Carp::Clan - Report errors from perspective of caller of a "clan" of modules

	  http://search.cpan.org/~kentnl/Carp-Clan-6.06/lib/Carp/Clan.pod
```

## package/perl-cgi/Config.in
```kconfig
config BR2_PACKAGE_PERL_CGI
	bool "perl-cgi"
	help
	  CGI - Handle Common Gateway Interface requests and responses

	  http://search.cpan.org/~leejo/CGI-4.31/lib/CGI.pod
```

## package/perl-class-accessor-chained/Config.in
```kconfig
config BR2_PACKAGE_PERL_CLASS_ACCESSOR_CHAINED
	bool "perl-class-accessor-chained"
	help
	  Class::Accessor::Chained - make chained accessors

	  http://search.cpan.org/~rclamp/Class-Accessor-Chained-0.01/lib/Class/Accessor/Chained.pm
```

## package/perl-class-accessor-fast/Config.in
```kconfig
config BR2_PACKAGE_PERL_CLASS_ACCESSOR_FAST
	bool "perl-class-accessor-fast"
	help
	  Class::Accessor::Fast - Faster, but less expandable, accessors

	  http://search.cpan.org/~kasei/Class-Accessor-0.34/lib/Class/Accessor/Fast.pm
```

## package/perl-class-accessor-grouped/Config.in
```kconfig
config BR2_PACKAGE_PERL_CLASS_ACCESSOR_GROUPED
	bool "perl-class-accessor-grouped"
	help
	  Class::Accessor::Grouped - Lets you build groups of accessors

	  http://search.cpan.org/~ribasushi/Class-Accessor-Grouped-0.10012/lib/Class/Accessor/Grouped.pm
```

## package/perl-class-c3-componentised/Config.in
```kconfig
config BR2_PACKAGE_PERL_CLASS_C3_COMPONENTISED
	bool "perl-class-c3-componentised"
	help
	  Class::C3::Componentised

	  http://search.cpan.org/~frew/Class-C3-Componentised-1.001000/lib/Class/C3/Componentised.pm
```

## package/perl-class-c3-xs/Config.in
```kconfig
config BR2_PACKAGE_PERL_CLASS_C3_XS
	bool "perl-class-c3-xs"
	help
	  Class::C3::XS - XS speedups for Class::C3
```

## package/perl-class-data-inheritable/Config.in
```kconfig
config BR2_PACKAGE_PERL_CLASS_DATA_INHERITABLE
	bool "perl-class-data-inheritable"
	help
	  Class::Data::Inheritable - Inheritable, overridable class data

	  http://search.cpan.org/~tmtm/Class-Data-Inheritable-0.08/lib/Class/Data/Inheritable.pm
```

## package/perl-class-inspector/Config.in
```kconfig
config BR2_PACKAGE_PERL_CLASS_INSPECTOR
	bool "perl-class-inspector"
	help
	  Class::Inspector - Get information about a class and its structure

	  http://search.cpan.org/~adamk/Class-Inspector-1.28/lib/Class/Inspector.pm
```

## package/perl-class-isa/Config.in
```kconfig
config BR2_PACKAGE_PERL_CLASS_ISA
	bool "perl-class-isa"
	help
	  Class::ISA - report the search path for a class's ISA tree

	  http://search.cpan.org/~smueller/Class-ISA-0.36/lib/Class/ISA.pm
```

## package/perl-class-virtual/Config.in
```kconfig
config BR2_PACKAGE_PERL_CLASS_VIRTUAL
	bool "perl-class-virtual"
	select BR2_PACKAGE_PERL_CLASS_ISA
	help
	  Class::Virtual - Base class for virtual base classes.

	  http://search.cpan.org/~mschwern/Class-Virtual-0.07/lib/Class/Virtual.pm
```

## package/perl-class-xsaccessor/Config.in
```kconfig
config BR2_PACKAGE_PERL_CLASS_XSACCESSOR
	bool "perl-class-xsaccessor"
	help
	  Class::XSAccessor - Generate fast XS accessors without runtime compilation

	  http://search.cpan.org/~smueller/Class-XSAccessor-1.19/lib/Class/XSAccessor.pm
```

## package/perl-common-sense/Config.in
```kconfig
config BR2_PACKAGE_PERL_COMMON_SENSE
	bool "perl-common-sense"
	help
	  common::sense - save a tree AND a kitten, use common::sense!

	  http://search.cpan.org/~mlehmann/common-sense-3.74/sense.pod
```
