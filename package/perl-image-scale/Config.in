## package/perl-image-scale/Config.in
```kconfig
config BR2_PACKAGE_PERL_IMAGE_SCALE
	bool "perl-image-scale"
	select BR2_PACKAGE_JPEG
	select BR2_PACKAGE_GIFLIB
	select BR2_PACKAGE_LIBPNG
	help
	  Image::Scale - Fast, high-quality fixed-point image resizing

	  http://search.cpan.org/~agrundma/Image-Scale-0.12/lib/Image/Scale.pm
```

## package/perl-io-aio/Config.in
```kconfig
config BR2_PACKAGE_PERL_IO_AIO
	bool "perl-io-aio"
	help
	  IO::AIO - Asynchronous Input/Output

	  http://search.cpan.org/~mlehmann/IO-AIO-4.34/AIO.pm
```

## package/perl-io-interface/Config.in
```kconfig
config BR2_PACKAGE_PERL_IO_INTERFACE
	bool "perl-io-interface"
	help
	  IO::Interface - Perl extension for access to network card configuration information

	  http://search.cpan.org/~lds/IO-Interface-1.09/lib/IO/Interface.pm
```

## package/perl-io-string/Config.in
```kconfig
config BR2_PACKAGE_PERL_IO_STRING
	bool "perl-io-string"
	help
	  IO::String - Emulate file interface for in-core strings

	  http://search.cpan.org/~gaas/IO-String-1.08/String.pm
```

## package/perl-json-xs-versiononeandtwo/Config.in
```kconfig
config BR2_PACKAGE_PERL_JSON_XS_VERSIONONEANDTWO
	bool "perl-json-xs-versiononeandtwo"
	help
	  JSON::XS::VersionOneAndTwo - Support versions 1 and 2 of JSON::XS

	  http://search.cpan.org/~lbrocard/JSON-XS-VersionOneAndTwo-0.31/lib/JSON/XS/VersionOneAndTwo.pm
```

## package/perl-json-xs/Config.in
```kconfig
config BR2_PACKAGE_PERL_JSON_XS
	bool "perl-json-xs"
	select BR2_PACKAGE_PERL_TYPES_SERIALISER
	help
	  JSON::XS - JSON serialising/deserialising, done correctly and fast

	  http://search.cpan.org/~mlehmann/JSON-XS-3.02/XS.pm
```

## package/perl-linux-inotify2/Config.in
```kconfig
config BR2_PACKAGE_PERL_LINUX_INOTIFY2
	bool "perl-linux-inotify2"
	help
	  Linux::Inotify2 - scalable directory/file change notification

	  http://search.cpan.org/~mlehmann/Linux-Inotify2-1.22/Inotify2.pm
```

## package/perl-log-log4perl/Config.in
```kconfig
config BR2_PACKAGE_PERL_LOG_LOG4PERL
	bool "perl-log-log4perl"
	help
	  Log::Log4perl - Log4j implementation for Perl

	  http://search.cpan.org/~mschilli/Log-Log4perl-1.47/lib/Log/Log4perl.pm
```

## package/perl-module-build-tiny/Config.in
```kconfig
config BR2_PACKAGE_PERL_MODULE_BUILD_TINY
	bool "perl-module-build-tiny"
	help
	  Module::Build::Tiny - A tiny replacement for Module::Build

	  http://search.cpan.org/~leont/Module-Build-Tiny-0.039/lib/Module/Build/Tiny.pm
```

## package/perl-module-build/Config.in
```kconfig
config BR2_PACKAGE_PERL_MODULE_BUILD
	bool "perl-module-build"
	help
	  Build and install Perl modules

	  https://metacpan.org/release/Module-Build
```

## package/perl-module-implementation/Config.in
```kconfig
config BR2_PACKAGE_PERL_MODULE_IMPLEMENTATION
	bool "perl-module-implementation"
	help
	  Module::Implementation - Loads one of several alternate underlying implementations for a module

	  http://search.cpan.org/~drolsky/Module-Implementation-0.09/lib/Module/Implementation.pm
```

## package/perl-module-runtime/Config.in
```kconfig
config BR2_PACKAGE_PERL_MODULE_RUNTIME
	bool "perl-module-runtime"
	help
	  Module::Runtime - runtime module handling

	  http://search.cpan.org/~zefram/Module-Runtime-0.014/lib/Module/Runtime.pm
```

## package/perl-moo/Config.in
```kconfig
config BR2_PACKAGE_PERL_MOO
	bool "perl-moo"
	help
	  Moo - Minimalist Object Orientation (with Moose compatibility)

	  http://search.cpan.org/~haarg/Moo-2.002004/lib/Moo.pm
```

## package/perl-mp3-cut-gapless/Config.in
```kconfig
config BR2_PACKAGE_PERL_MP3_CUT_GAPLESS
	bool "perl-mp3-cut-gapless"
	help
	  MP3::Cut::Gapless - Split an MP3 file without gaps (based on pcutmp3)

	  http://search.cpan.org/~agrundma/MP3-Cut-Gapless-0.03/lib/MP3/Cut/Gapless.pm
```

## package/perl-mro-compat/Config.in
```kconfig
config BR2_PACKAGE_PERL_MRO_COMPAT
	bool "perl-mro-compat"
	help
	  MRO::Compat - mro::* interface compatibility for Perls < 5.9.5

	  http://search.cpan.org/~bobtfish/MRO-Compat-0.12/lib/MRO/Compat.pm
```

## package/perl-namespace-clean/Config.in
```kconfig
config BR2_PACKAGE_PERL_NAMESPACE_CLEAN
	bool "perl-namespace-clean"
	help
	  namespace::clean - Keep imports and functions out of your namespace

	  http://search.cpan.org/~ribasushi/namespace-clean-0.27/lib/namespace/clean.pm
```

## package/perl-network-ipv4addr/Config.in
```kconfig
config BR2_PACKAGE_PERL_NETWORK_IPV4ADDR
	bool "perl-network-ipv4addr"
	help
	  Network::IPv4Addr - Perl extension for manipulating IPv4 addresses.

	  http://search.cpan.org/~frajulac/Network-IPv4Addr-0.05/IPv4Addr.pm
```

## package/perl-package-stash/Config.in
```kconfig
config BR2_PACKAGE_PERL_PACKAGE_STASH
	bool "perl-package-stash"
	help
	  Package::Stash - routines for manipulating stashes

	  http://search.cpan.org/~doy/Package-Stash-0.37/lib/Package/Stash.pm
```

## package/perl-path-class/Config.in
```kconfig
config BR2_PACKAGE_PERL_PATH_CLASS
	bool "perl-path-class"
	help
	  Path::Class - Cross-platform path specification manipulation for Perl

	  http://search.cpan.org/~kwilliams/Path-Class-0.36/README.pod
```

## package/perl-proc-background/Config.in
```kconfig
config BR2_PACKAGE_PERL_PROC_BACKGROUND
	bool "perl-proc-background"
	help
	  Proc::Background - Generic interface to Unix and Win32 background process management

	  http://search.cpan.org/~bzajac/Proc-Background-1.10/lib/Proc/Background.pm
```

## package/perl-readonly/Config.in
```kconfig
config BR2_PACKAGE_PERL_READONLY
	bool "perl-readonly"
	help
	  Readonly - Facility for creating read-only scalars, arrays, hashes

	  http://search.cpan.org/~sanko/Readonly-2.05/lib/Readonly.pm
```

## package/perl-sql-abstract-limit/Config.in
```kconfig
config BR2_PACKAGE_PERL_SQL_ABSTRACT_LIMIT
	bool "perl-sql-abstract-limit"
	help
	  SQL::Abstract::Limit - portable LIMIT emulation

	  http://search.cpan.org/~davebaird/SQL-Abstract-Limit-0.141/lib/SQL/Abstract/Limit.pm
```

## package/perl-sql-abstract/Config.in
```kconfig
config BR2_PACKAGE_PERL_SQL_ABSTRACT
	bool "perl-sql-abstract"
	help
	  SQL::Abstract - Generate SQL from Perl data structures

	  http://search.cpan.org/~ribasushi/SQL-Abstract-1.81/lib/SQL/Abstract.pm
```

## package/perl-sub-exporter-progressive/Config.in
```kconfig
config BR2_PACKAGE_PERL_SUB_EXPORTER_PROGRESSIVE
	bool "perl-sub-exporter-progressive"
	help
	  Sub::Exporter::Progressive - Only use Sub::Exporter if you need it

	  http://search.cpan.org/~frew/Sub-Exporter-Progressive-0.001011/lib/Sub/Exporter/Progressive.pm
```

## package/perl-sub-name/Config.in
```kconfig
config BR2_PACKAGE_PERL_SUB_NAME
	bool "perl-sub-name"
	help
	  Sub::Name - (re)name a sub

	  http://search.cpan.org/~ether/Sub-Name-0.15/lib/Sub/Name.pm
```
