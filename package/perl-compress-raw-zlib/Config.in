## package/perl-compress-raw-zlib/Config.in
```kconfig
config BR2_PACKAGE_PERL_COMPRESS_RAW_ZLIB
	bool "perl-compress-raw-zlib"
	help
	  Compress::Raw::Zlib - Low-Level Interface to zlib compression library

	  http://search.cpan.org/~pmqs/Compress-Raw-Zlib-2.069/lib/Compress/Raw/Zlib.pm
```

## package/perl-context-preserve/Config.in
```kconfig
config BR2_PACKAGE_PERL_CONTEXT_PRESERVE
	bool "perl-context-preserve"
	help
	  Context::Preserve - run code after a subroutine call, preserving the context the subroutine would have seen if it were the last statement in the caller

	  http://search.cpan.org/~jrockway/Context-Preserve-0.01/lib/Context/Preserve.pm
```

## package/perl-data-dump/Config.in
```kconfig
config BR2_PACKAGE_PERL_DATA_DUMP
	bool "perl-data-dump"
	help
	  Data::Dump - Pretty printing of data structures

	  http://search.cpan.org/~gaas/Data-Dump-1.23/lib/Data/Dump.pm
```

## package/perl-data-page/Config.in
```kconfig
config BR2_PACKAGE_PERL_DATA_PAGE
	bool "perl-data-page"
	help
	  Data::Page - help when paging through sets of results

	  http://search.cpan.org/~lbrocard/Data-Page-2.02/lib/Data/Page.pm
```

## package/perl-data-uriencode/Config.in
```kconfig
config BR2_PACKAGE_PERL_DATA_URIENCODE
	bool "perl-data-uriencode"
	help
	  Data::URIEncode - Allow complex data structures to be encoded using flat URIs.

	  http://search.cpan.org/~rhandom/Data-URIEncode-0.11/lib/Data/URIEncode.pm
```

## package/perl-dbd-mysql/Config.in
```kconfig
config BR2_PACKAGE_PERL_DBD_MYSQL
	bool "perl-dbd-mysql"
	select BR2_PACKAGE_MYSQL
	select BR2_PACKAGE_OPENSSL
	select BR2_PACKAGE_PERL_DBI
	help
	  DBD::mysql - MySQL driver for the Perl5 Database Interface (DBI)

	  http://search.cpan.org/~michielb/DBD-mysql-4.034/lib/DBD/mysql.pm
```

## package/perl-dbd-sqlite/Config.in
```kconfig
config BR2_PACKAGE_PERL_DBD_SQLITE
	bool "perl-dbd-sqlite"
	help
	  DBD::SQLite - Self-contained RDBMS in a DBI Driver

	  http://search.cpan.org/dist/DBD-SQLite/lib/DBD/SQLite.pm
```

## package/perl-dbi/Config.in
```kconfig
config BR2_PACKAGE_PERL_DBI
	bool "perl-dbi"
	help
	  DBI - Database independent interface for Perl

	  http://search.cpan.org/~timb/DBI-1.636/DBI.pm
```

## package/perl-dbix-class/Config.in
```kconfig
config BR2_PACKAGE_PERL_DBIX_CLASS
	bool "perl-dbix-class"
	select BR2_PACKAGE_PERL_MOO
	select BR2_PACKAGE_PERL_MODULE_RUNTIME
	select BR2_PACKAGE_PERL_DEVEL_GLOBALDESTRUCTION
	select BR2_PACKAGE_PERL_SUB_EXPORTER_PROGRESSIVE
	select BR2_PACKAGE_PERL_CLASS_C3_COMPONENTISED
	select BR2_PACKAGE_PERL_MRO_COMPAT
	select BR2_PACKAGE_PERL_NAMESPACE_CLEAN
	select BR2_PACKAGE_PERL_B_HOOKS_ENDOFSCOPE
	select BR2_PACKAGE_PERL_MODULE_IMPLEMENTATION
	select BR2_PACKAGE_PERL_TRY_TINY
	select BR2_PACKAGE_PERL_PACKAGE_STASH
	help
	  DBIx::Class - Extensible and flexible object <-> relational mapper.

	  http://search.cpan.org/~ribasushi/DBIx-Class-0.082840/lib/DBIx/Class.pod
```

## package/perl-devel-checklib/Config.in
```kconfig
config BR2_PACKAGE_PERL_DEVEL_CHECKLIB
	bool "perl-devel-checklib"
	help
	  Devel::CheckLib - check that a library is available

	  http://search.cpan.org/~mattn/Devel-CheckLib-1.07/lib/Devel/CheckLib.pm
```

## package/perl-devel-globaldestruction/Config.in
```kconfig
config BR2_PACKAGE_PERL_DEVEL_GLOBALDESTRUCTION
	bool "perl-devel-globaldestruction"
	help
          Devel::GlobalDestruction - Provides function returning the
          equivalent of ${^GLOBAL_PHASE} eq 'DESTRUCT' for older perls.

	  http://search.cpan.org/~haarg/Devel-GlobalDestruction-0.13/lib/Devel/GlobalDestruction.pm
```

## package/perl-enum/Config.in
```kconfig
config BR2_PACKAGE_PERL_ENUM
	bool "perl-enum"
	help
	  enum - C style enumerated types and bitmask flags in Perl

	  http://search.cpan.org/~neilb/enum-1.11/lib/enum.pm
```

## package/perl-ev/Config.in
```kconfig
config BR2_PACKAGE_PERL_EV
	bool "perl-ev"
	select BR2_PACKAGE_LIBEV
	help
	  EV - perl interface to libev, a high performance full-featured event loop
```

## package/perl-exporter-lite/Config.in
```kconfig
config BR2_PACKAGE_PERL_EXPORTER_LITE
	bool "perl-exporter-lite"
	help
	  Exporter::Lite - lightweight exporting of functions and variables

	  http://search.cpan.org/~neilb/Exporter-Lite-0.08/lib/Exporter/Lite.pm
```

## package/perl-extutils-cbuilder/Config.in
```kconfig
config BR2_PACKAGE_PERL_EXTUTILS_CBUILDER
	bool "perl-extutils-cbuilder"
	help
	  ExtUtils::CBuilder - Compile and link C code for Perl modules

	  http://search.cpan.org/~ambs/ExtUtils-CBuilder-0.280224/lib/ExtUtils/CBuilder.pm
```

## package/perl-extutils-config/Config.in
```kconfig
config BR2_PACKAGE_PERL_EXTUTILS_CONFIG
	bool "perl-extutils-config"
	help
	  ExtUtils::Config - A wrapper for perl's configuration

	  http://search.cpan.org/~leont/ExtUtils-Config-0.008/lib/ExtUtils/Config.pm
```

## package/perl-extutils-helpers/Config.in
```kconfig
config BR2_PACKAGE_PERL_EXTUTILS_HELPERS
	bool "perl-extutils-helpers"
	help
	  ExtUtils::Helpers - Various portability utilities for module builders

	  http://search.cpan.org/~leont/ExtUtils-Helpers-0.022/lib/ExtUtils/Helpers.pm
```

## package/perl-extutils-installpaths/Config.in
```kconfig
config BR2_PACKAGE_PERL_EXTUTILS_INSTALLPATHS
	bool "perl-extutils-installpaths"
	help
	  ExtUtils::InstallPaths - Build.PL install path logic made easy

	  http://search.cpan.org/~leont/ExtUtils-InstallPaths-0.011/lib/ExtUtils/InstallPaths.pm
```

## package/perl-file-bom/Config.in
```kconfig
config BR2_PACKAGE_PERL_FILE_BOM
	bool "perl-file-bom"
	select BR2_PACKAGE_PERL_READONLY
	help
	  File::BOM - Utilities for handling Byte Order Marks

	  http://search.cpan.org/~mattlaw/File-BOM-0.15/lib/File/BOM.pm
```

## package/perl-file-next/Config.in
```kconfig
config BR2_PACKAGE_PERL_FILE_NEXT
	bool "perl-file-next"
	help
	  File::Next - File-finding iterator

	  http://search.cpan.org/~petdance/File-Next-1.16/Next.pm
```

## package/perl-file-readbackwards/Config.in
```kconfig
config BR2_PACKAGE_PERL_FILE_READBACKWARDS
	bool "perl-file-readbackwards"
	help
	  File::ReadBackwards.pm -- Read a file backwards by lines.

	  http://search.cpan.org/~uri/File-ReadBackwards-1.05/ReadBackwards.pm
```

## package/perl-file-slurp-tiny/Config.in
```kconfig
config BR2_PACKAGE_PERL_FILE_SLURP_TINY
	bool "perl-file-slurp-tiny"
	help
	  File::Slurp::Tiny - A simple, sane and efficient file slurper [DISCOURAGED]

	  http://search.cpan.org/~leont/File-Slurp-Tiny-0.004/lib/File/Slurp/Tiny.pm
```

## package/perl-file-slurp/Config.in
```kconfig
config BR2_PACKAGE_PERL_FILE_SLURP
	bool "perl-file-slurp"
	help
	  File::Slurp - Simple and Efficient Reading/Writing/Modifying of Complete Files

	  http://search.cpan.org/~uri/File-Slurp-9999.19/lib/File/Slurp.pm
```

## package/perl-file-which/Config.in
```kconfig
config BR2_PACKAGE_PERL_FILE_WHICH
	bool "perl-file-which"
	help
	  File::Which - Perl implementation of the which utility as an API

	  http://search.cpan.org/~plicease/File-Which-1.21/lib/File/Which.pm
```

## package/perl-font-freetype/Config.in
```kconfig
config BR2_PACKAGE_PERL_FONT_FREETYPE
	bool "perl-font-freetype"
	select BR2_PACKAGE_FREETYPE
	help
	  Font::FreeType - read font files and render glyphs from Perl using FreeType2

	  http://search.cpan.org/~dmol/Font-FreeType-0.07/lib/Font/FreeType.pm
```
