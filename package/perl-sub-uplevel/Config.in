## package/perl-sub-uplevel/Config.in
```kconfig
config BR2_PACKAGE_PERL_SUB_UPLEVEL
	bool "perl-sub-uplevel"
	help
	  Sub::Uplevel - apparently run a function in a higher stack frame

	  http://search.cpan.org/~dagolden/Sub-Uplevel-0.25/lib/Sub/Uplevel.pm
```

## package/perl-template-toolkit/Config.in
```kconfig
config BR2_PACKAGE_PERL_TEMPLATE_TOOLKIT
	bool "perl-template-toolkit"
	help
	  Template::Toolkit - Template Processing System

	  http://search.cpan.org/~abw/Template-Toolkit-2.26/lib/Template/Toolkit.pod
```

## package/perl-text-unidecode/Config.in
```kconfig
config BR2_PACKAGE_PERL_TEXT_UNIDECODE
	bool "perl-text-unidecode"
	help
	  Text::Unidecode -- plain ASCII transliterations of Unicode text

	  http://search.cpan.org/~sburke/Text-Unidecode-1.27/lib/Text/Unidecode.pm
```

## package/perl-tie-cache-lru-expires/Config.in
```kconfig
config BR2_PACKAGE_PERL_TIE_CACHE_LRU_EXPIRES
	bool "perl-tie-cache-lru-expires"
	help
	  Tie::Cache::LRU::Expires - Extends Tie::Cache::LRU with expiring

	  http://search.cpan.org/~oesterhol/Tie-Cache-LRU-Expires-0.55/Expires.pm
```

## package/perl-tie-cache-lru/Config.in
```kconfig
config BR2_PACKAGE_PERL_TIE_CACHE_LRU
	bool "perl-tie-cache-lru"
	select BR2_PACKAGE_PERL_CARP_ASSERT
	select BR2_PACKAGE_PERL_CLASS_VIRTUAL
	select BR2_PACKAGE_PERL_ENUM
	help
	  Tie::Cache::LRU - A Least-Recently Used cache

	  http://search.cpan.org/~mschwern/Tie-Cache-LRU-20150301/lib/Tie/Cache/LRU.pm
```

## package/perl-tie-regexphash/Config.in
```kconfig
config BR2_PACKAGE_PERL_TIE_REGEXPHASH
	bool "perl-tie-regexphash"
	help
	  Tie::RegexpHash - Use regular expressions as hash keys

	  http://search.cpan.org/~altreus/Tie-RegexpHash-0.17/lib/Tie/RegexpHash.pm
```

## package/perl-tree-dag_node/Config.in
```kconfig
config BR2_PACKAGE_PERL_TREE_DAG_NODE
	bool "perl-tree-dag_node"
	select BR2_PACKAGE_PERL_FILE_SLURP_TINY
	help
	  Tree::DAG_Node - An N-ary tree

	  http://search.cpan.org/~rsavage/Tree-DAG_Node-1.29/lib/Tree/DAG_Node.pm
```

## package/perl-types-serialiser/Config.in
```kconfig
config BR2_PACKAGE_PERL_TYPES_SERIALISER
	bool "perl-types-serialiser"
	help
	  Types::Serialiser - simple data types for common serialisation formats

	  http://search.cpan.org/~mlehmann/Types-Serialiser-1.0/Serialiser.pm
```

## package/perl-uri-find/Config.in
```kconfig
config BR2_PACKAGE_PERL_URI_FIND
	bool "perl-uri-find"
	help
	  URI::Find - Find URIs in arbitrary text

	  http://search.cpan.org/~mschwern/URI-Find-20140709/lib/URI/Find.pm
```

## package/perl-uuid-tiny/Config.in
```kconfig
config BR2_PACKAGE_PERL_UUID_TINY
	bool "perl-uuid-tiny"
	help
	  UUID::Tiny - Pure Perl UUID Support With Functional Interface

	  http://search.cpan.org/~caugustin/UUID-Tiny-1.04/lib/UUID/Tiny.pm
```

## package/perl-xml-parser/Config.in
```kconfig
config BR2_PACKAGE_PERL_XML_PARSER
	bool "perl-xml-parser"
	help
	  XML::Parser - A perl module for parsing XML documents

	  http://search.cpan.org/~toddr/XML-Parser-2.44/Parser.pm
```

## package/perl-xml-simple/Config.in
```kconfig
config BR2_PACKAGE_PERL_XML_SIMPLE
	bool "perl-xml-simple"
	help
	  XML::Simple - An API for simple XML files

	  http://search.cpan.org/~grantm/XML-Simple-2.22/lib/XML/Simple.pm
```

## package/perl-yaml-xs/Config.in
```kconfig
config BR2_PACKAGE_PERL_YAML_XS
	bool "perl-yaml-xs"
	help
	  YAML::XS - Perl YAML Serialization using XS and libyaml

	  http://search.cpan.org/dist/YAML-LibYAML/lib/YAML/XS.pod
```

## package/slimserver/Config.in
```kconfig
config BR2_PACKAGE_SLIMSERVER
	bool "slimserver"
	depends on BR2_USE_MMU
	depends on BR2_TOOLCHAIN_HAS_THREADS_NPTL
	select BR2_PACKAGE_PERL
	select BR2_PACKAGE_EXPAT
	select BR2_PACKAGE_PERL_AUDIO_CUEFILE_PARSER
	select BR2_PACKAGE_PERL_AUDIO_SCAN
	select BR2_PACKAGE_PERL_CLASS_C3_XS
	select BR2_PACKAGE_PERL_CLASS_XSACCESSOR
	select BR2_PACKAGE_PERL_COMMON_SENSE
	select BR2_PACKAGE_PERL_COMPRESS_RAW_ZLIB
	select BR2_PACKAGE_PERL_DATA_DUMP
	select BR2_PACKAGE_PERL_DBD_MYSQL
	select BR2_PACKAGE_PERL_DBD_SQLITE
	select BR2_PACKAGE_PERL_DIGEST_SHA1
	select BR2_PACKAGE_PERL_ENCODE_DETECT
	select BR2_PACKAGE_PERL_EXTUTILS_CBUILDER
	select BR2_PACKAGE_PERL_EV
	select BR2_PACKAGE_PERL_FONT_FREETYPE
	select BR2_PACKAGE_PERL_HTML_PARSER
	select BR2_PACKAGE_PERL_HTML_TAGSET
	select BR2_PACKAGE_PERL_IMAGE_SCALE
	select BR2_PACKAGE_PERL_IO_AIO
	select BR2_PACKAGE_PERL_IO_INTERFACE
	select BR2_PACKAGE_PERL_JSON_XS
	select BR2_PACKAGE_PERL_LINUX_INOTIFY2
	select BR2_PACKAGE_PERL_MP3_CUT_GAPLESS
	select BR2_PACKAGE_PERL_SUB_NAME
	select BR2_PACKAGE_PERL_SUB_UPLEVEL
	select BR2_PACKAGE_PERL_TEMPLATE_TOOLKIT
	select BR2_PACKAGE_PERL_TREE_DAG_NODE
	select BR2_PACKAGE_PERL_XML_PARSER
	help
	  Logitech slimserver
```

## package/swh-ladspa-plugins/Config.in
```kconfig
config BR2_PACKAGE_SWH_LADSPA_PLUGINS
	bool "swh-ladspa-plugins"
	select BR2_PACKAGE_ALSA_LIB
	help
	  The SWH Plugins package for the LADSPA plugin system

	  https://github.com/swh/ladspa
```
